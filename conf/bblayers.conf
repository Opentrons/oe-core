## conf/bblayers.conf
```bitbake
# LAYER_CONF_VERSION is increased each time build/conf/bblayers.conf
# changes incompatibly
LCONF_VERSION = "7"

BBPATH = "${TOPDIR}"
BBFILES ?= ""

BBLAYERS ?= " \
  ${TOPDIR}/../layers/meta-opentrons \
  ${TOPDIR}/../layers/meta-jupyter \
  ${TOPDIR}/../layers/meta-toradex-nxp \
  ${TOPDIR}/../layers/meta-freescale \
  ${TOPDIR}/../layers/meta-freescale-3rdparty \
  ${TOPDIR}/../layers/meta-toradex-bsp-common \
  ${TOPDIR}/../layers/meta-openembedded/meta-oe \
  ${TOPDIR}/../layers/meta-openembedded/meta-filesystems \
  ${TOPDIR}/../layers/meta-openembedded/meta-gnome \
  ${TOPDIR}/../layers/meta-openembedded/meta-webserver \
  ${TOPDIR}/../layers/meta-openembedded/meta-xfce \
  ${TOPDIR}/../layers/meta-openembedded/meta-initramfs \
  ${TOPDIR}/../layers/meta-openembedded/meta-networking \
  ${TOPDIR}/../layers/meta-openembedded/meta-multimedia \
  ${TOPDIR}/../layers/meta-openembedded/meta-python \
  ${TOPDIR}/../layers/meta-freescale-distro \
  ${TOPDIR}/../layers/meta-toradex-demos \
  ${TOPDIR}/../layers/meta-qt5 \
  ${TOPDIR}/../layers/meta-toradex-distro \
  ${TOPDIR}/../layers/meta-yocto/meta-poky \
  ${TOPDIR}/../layers/openembedded-core/meta \
  "
```

## layers/meta-opentrons/conf/distro/opentrons.conf
```bitbake
require ../meta-toradex-distro/conf/distro/tdx-xwayland.conf

DISTRO = "opentrons"
DISTRO_NAME = "Opentrons (Opentrons OT3 Distro)"
DISTRO_VERSION = "0.0.1"
DISTRO_CODENAME = "ot3"
DISTRO_FEATURES:append = " systemd wifi bluetooth udev"
DISTRO_FEATURES:remove = "tpm2"
DISTRO_FEATURES_BACKFILL_CONSIDERED += "sysvinit"
VIRTUAL-RUNTIME_init_manager = "systemd"
VIRTUAL-RUNTIME_initscripts = "systemd-compat-units"

PREFERRED_VERSION_u-boot-toradex = "2022.07"
PREFERRED_VERSION_libgpiod = "1.6.4"
PREFERRED_VERSION_icu = "73.2"
PREFERRED_VERSION_c-ares = "1.17.1"
PREFERRED_VERSION_libical = "3.0.10"
PREFERRED_VERSION_hidapi = "0.11.2"
PREFERRED_VERSION_python3-pyjwt = "2.6.0"
PREFERRED_VERSION_python3-setuptools = "68.2.2"
PREFERRED_VERSION_python3-setuptools-scm = "8.2.1"
PREFERRED_VERSION_python3-jupyter-packaging = "0.12.0"
PREFERRED_VERSION_python3-packaging = "24.2"
PREFERRED_VERSION_nodejs = "22.12.0"
PREFERRED_VERSION_python3-wrapt = "1.16.0"
PREFERRED_VERSION_vulkan-tools = "1.2.182.0"
PREFERRED_VERSION_vulkan-headers = "1.2.182.0"
PREFERRED_VERSION_vulkan-loader = "1.2.182.0"
PREFERRED_VERSION_python3-setuptools-rust = "1.10.2"
PREFERRED_VERSION_rust = "1.75.0"
PREFERRED_VERSION_rust-cross-canadian = "1.75.0"
PREFERRED_VERSION_libstd-rs = "1.75.0"
PREFERRED_VERSION_rust-llvm = "1.75.0"
PREFERRED_VERSION_cargo = "1.75.0"
PREFERRED_VERSION_cargo-native = "1.75.0"
PREFERRED_VERSION_cargo-c = "0.9.18"
PREFERRED_VERSION_rust-native = "1.75.0"
PREFERRED_VERSION_rust-llvm-native = "1.75.0"
PREFERRED_VERSION_librsvg = "2.56.3"
```

## layers/meta-opentrons/conf/layer.conf
```bitbake
# We have a conf and classes directory, add to BBPATH
BBPATH .= ":${LAYERDIR}"

# We have recipes-* directories, add to BBFILES
BBFILES += "${LAYERDIR}/recipes-*/*/*.bb \
            ${LAYERDIR}/recipes-*/*/*.bbappend \
            ${LAYERDIR}/recipes-*/*.bb \
            ${LAYERDIR}/recipes-*/*.bbappend \
            "

BBFILE_COLLECTIONS += "meta-opentrons"
BBFILE_PATTERN_meta-opentrons = "^${LAYERDIR}/"
BBFILE_PRIORITY_meta-opentrons = "8"

LAYERDEPENDS_meta-opentrons = "core"
LAYERSERIES_COMPAT_meta-opentrons = "kirkstone"
```

## layers/meta-opentrons/conf/machine/verdin-imx8mm.conf
```bitbake
#@TYPE: Machine
#@NAME: Toradex Verdin iMX8M Mini
#@SOC: i.MX8MM
#@DESCRIPTION: Machine configuration for Toradex Verdin iMX8M Mini SoM
#@MAINTAINER: Max Krummenacher <max.krummenacher@toradex.com>

MACHINE_NAME = "Verdin-iMX8MM"

MACHINEOVERRIDES =. "mx8:mx8m:mx8mm:"

IMX_DEFAULT_BSP = "nxp"

require conf/machine/include/imx-base.inc
# override imx-base.inc which sets this to cortexa53-crypto
DEFAULTTUNE:mx8mm-generic-bsp = "armv8a-crypto"
require conf/machine/include/arm/armv8a/tune-cortexa53.inc
# Don't include kernels in standard images
RRECOMENDS:${KERNEL_PACKAGE_NAME}-base = ""

KERNEL_DEVICETREE = " \
    freescale/imx8mm-verdin-nonwifi-dahlia.dtb \
    freescale/imx8mm-verdin-nonwifi-dev.dtb \
    freescale/imx8mm-verdin-wifi-dahlia.dtb \
    freescale/imx8mm-verdin-wifi-dev.dtb \
"
KERNEL_IMAGETYPE:aarch64 = "Image.gz"

UBOOT_CONFIG ??= "sd"
UBOOT_CONFIG[sd] = "verdin-imx8mm_defconfig,sdcard"
SPL_BINARY = "spl/u-boot-spl.bin"

# evaluate - these are more recent from meta-toradex-nxp
#UBOOT_DTB_LOADADDRESS:mx8mm-generic-bsp = "0x50200000"
#UBOOT_DTBO_LOADADDRESS:mx8mm-generic-bsp = "0x50240000"
#UBOOT_ENTRYPOINT:mx8mm-generic-bsp  = "0x48200000"
#UBOOT_RD_LOADADDRESS = "0x52300000"

# evaluate - these are the older values from dunfell
UBOOT_ENTRYPOINT:mx8mm-generic-bsp = "0x40280000"
UBOOT_DTB_LOADADDRESS:mx8mm-generic-bsp = "0x43000000"
UBOOT_DTBO_LOADADDRESS:mx8mm-generic-bsp = "0x46000000"
UBOOT_RD_LOADADDRESS = "0x60000000"

# Set DDR FIRMWARE
DDR_FIRMWARE_NAME = "lpddr4_pmu_train_1d_imem.bin lpddr4_pmu_train_1d_dmem.bin lpddr4_pmu_train_2d_imem.bin lpddr4_pmu_train_2d_dmem.bin"

# Set u-boot DTB
UBOOT_DTB_NAME = "imx8mm-verdin.dtb"

BOOT_SPACE = "65536"

ATF_PLATFORM = "imx8mm"
SOC_ATF_BOOT_UART_BASE:verdin-imx8mm = "0x30860000"

# Set imx-mkimage boot target
IMXBOOT_TARGETS = "flash_evk_emmc_fastboot"
IMX_BOOT_SOC_TARGET = "iMX8MM"

IMAGE_BOOT_FILES:append = " boot.scr-${MACHINE};boot.scr"
WKS_FILE_DEPENDS:append = " u-boot-default-script"
PREFERRED_PROVIDER_u-boot-default-script = "u-boot-distro-boot"

LOADADDR = ""
UBOOT_SUFFIX = "bin"
UBOOT_MAKE_TARGET = ""
IMX_BOOT_SEEK = "33"

SERIAL_CONSOLES = "115200;ttymxc0"

MACHINE_FEATURES += "3g bluetooth alsa ext2 pci screen touchscreen usbgadget usbhost vfat wifi"

# handle machine firmware
MACHINE_FIRMWARE:append = " linux-firmware-ath10k linux-firmware-imx-sdma-imx7d"
MACHINE_FIRMWARE:append = " linux-firmware-sd8997"
MACHINE_FIRMWARE:append = " firmware-imx-vpu-imx8"

PREFERRED_PROVIDER_virtual/kernel = "linux-toradex"
PREFERRED_PROVIDER_virtual/kernel:preempt-rt = "linux-toradex"
PREFERRED_PROVIDER_virtual/kernel:use-mainline-bsp = "linux-toradex-mainline"
PREFERRED_PROVIDER_virtual/kernel:use-mainline-bsp:preempt-rt = "linux-toradex-mainline-rt"
PREFERRED_PROVIDER_virtual/dtb:use-mainline-bsp = "device-tree-overlays-mainline"
MACHINE_EXTRA_RRECOMMENDS:append:use-mainline-bsp = " modprobe-conf"
IMX_DEFAULT_BOOTLOADER = "u-boot-toradex"
# Currently we use the nxp 2022.04 downstream for mx8
PREFERRED_VERSION_u-boot-toradex = "2022.04"

PREFERRED_PROVIDER_virtual/bootloader = "u-boot-toradex"
PREFERRED_PROVIDER_u-boot = "u-boot-toradex"

# Updated gdk-pixbuf required for electron >=19
PREFERRED_VERSION_gdk-pixbuf = "2.42.9"
PREFERRED_VERSION_cmake-native = "3.22.3"

# ffmpeg
PREFERRED_PROVIDER_ffmpeg = "ffmpeg"

BOARD_TYPE = "verdin"

IMAGE_CLASSES:append = " image_type_tezi"
IMAGE_FSTYPES += "teziimg"

UBOOT_BINARY_TEZI_EMMC = "imx-boot"
OFFSET_BOOTROM_PAYLOAD = "2"

TEZI_EXTERNAL_KERNEL_DEVICETREE_BOOT = "\
  verdin-imx8mm_sn65dsi84-atm0700l61_overlay.dtbo \
  verdin-imx8mm_gt911_overlay.dtbo \
  verdin-imx8mm_MCP2518_overlay.dtbo \
  verdin-imx8mm_force-lcd-on.dtbo \
  verdin-imx8mm_M24128-eeprom_overlay.dtbo \
"

TEZI_EXTERNAL_KERNEL_DEVICETREE = "\
  verdin-imx8mm_sn65dsi84-atm0700l61_overlay.dtbo \
  verdin-imx8mm_gt911_overlay.dtbo \
  verdin-imx8mm_MCP2518_overlay.dtbo \
  verdin-imx8mm_force-lcd-on.dtbo \
  verdin-imx8mm_M24128-eeprom_overlay.dtbo \
"

TORADEX_PRODUCT_IDS = "0055 0057 0059 0060"
TORADEX_PRODUCT_IDS[0055] = "imx8mm-verdin-wifi-v1.1-dev.dtb"
TORADEX_PRODUCT_IDS[0057] = "imx8mm-verdin-nonwifi-v1.1-dev.dtb"
TORADEX_PRODUCT_IDS[0059] = "imx8mm-verdin-nonwifi-v1.1-dev.dtb"
TORADEX_PRODUCT_IDS[0060] = "imx8mm-verdin-wifi-v1.1-dev.dtb"
```

## layers/meta-toradex-wifi/conf/layer.conf
```bitbake
# We have a conf and classes directory, add to BBPATH
BBPATH .= ":${LAYERDIR}"

# We have recipes-* directories, add to BBFILES
BBFILES += "${LAYERDIR}/recipes-*/*/*.bb \
            ${LAYERDIR}/recipes-*/*/*.bbappend"

BBFILE_COLLECTIONS += "meta-toradex-wifi"
BBFILE_PATTERN_meta-toradex-wifi = "^${LAYERDIR}/"
BBFILE_PRIORITY_meta-toradex-wifi = "25"

LAYERDEPENDS_meta-toradex-wifi = "core toradex-bsp-common-layer"
LAYERSERIES_COMPAT_meta-toradex-wifi = "dunfell"
```
