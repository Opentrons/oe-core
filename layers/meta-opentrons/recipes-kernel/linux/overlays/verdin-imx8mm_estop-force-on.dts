// SPDX-License-Identifier: Apache-2
/*
 * Copyright 2020-2021 Opentrons
 */

// Force eSTOP (SODIMM_210) high on startup so the gripper + 96 channel dont plunge.

/dts-v1/;
/plugin/;

#include <imx8mm-pinfunc.h>
#include "dt-bindings/gpio/gpio.h"

/ {
    compatible = "toradex,verdin-imx8mm";
};

/* Verdin GPIO_3(pulled-up as active-low) */
&pinctrl_gpio3 {
    fsl,pins = <
        MX8MM_IOMUXC_UART3_RXD_GPIO5_IO26 0x146   /* SODIMM 210 */
    >;
};

&gpio5 {
    estop_enable: estop_enable {
        pinctrl-names = "default";
        pinctrl-0 = <&pinctrl_gpio3>;
        enable-gpios = <&gpio5 26 GPIO_ACTIVE_LOW>;
        status = "okay";
    };
};
